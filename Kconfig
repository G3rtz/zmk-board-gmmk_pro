## boards/arm/gmmk_pro/Kconfig.board
```kconfig
# Copyright (c) 2025 G3rtz
# SPDX-License-Identifier: MIT

config BOARD_GMMK_PRO
    def_bool $(boards_list_contains,gmmk_pro)
    depends on SOC_STM32F303XC
```

## boards/arm/gmmk_pro/Kconfig.defconfig
```kconfig
# Copyright (c) 2025 G3rtz
# SPDX-License-Identifier: MIT

if BOARD_GMMK_PRO

config ZMK_KEYBOARD_NAME
    default "GMMK Pro"

config ZMK_USB
    default y

config ZMK_KSCAN_MATRIX_POLLING
    default y

endif # BOARD_GMMK_PRO
```

## boards/arm/gmmk_pro/gmmk_pro_defconfig
```kconfig
# Copyright (c) 2025 G3rtz
# SPDX-License-Identifier: MIT
#
# Board-level Kconfig defaults for GMMK Pro

# SoC
CONFIG_SOC_SERIES_STM32F3X=y
CONFIG_SOC_STM32F303XC=y
CONFIG_SYS_CLOCK_HW_CYCLES_PER_SEC=72000000

# Board
CONFIG_BOARD_GMMK_PRO=y

# GPIO
CONFIG_GPIO=y

# Pin Control
CONFIG_PINCTRL=y

# Clock
CONFIG_CLOCK_CONTROL=y

# USB
CONFIG_USB_DEVICE_STACK=y
CONFIG_USB_DEVICE_VID=0x320F
CONFIG_USB_DEVICE_PID=0x5044
CONFIG_USB_DEVICE_MANUFACTURER="Glorious"
CONFIG_USB_DEVICE_PRODUCT="GMMK Pro"

# Bootloader
CONFIG_BOOTLOADER_STM32_DFU=y

# Flash/NVS for settings storage
CONFIG_FLASH=y
CONFIG_FLASH_MAP=y
CONFIG_NVS=y
CONFIG_SETTINGS=y
CONFIG_SETTINGS_NVS=y

# Encoder
CONFIG_EC11=y
CONFIG_EC11_TRIGGER_GLOBAL_THREAD=y

# HID
CONFIG_ZMK_HID_REPORT_TYPE_NKRO=y
```

## boards/glorious/gmmk_pro/Kconfig.defconfig
```kconfig
# Copyright (c) 2025 G3rtz
# SPDX-License-Identifier: MIT

if BOARD_GMMK_PRO || BOARD_GMMK_PRO_STM32F303XC_ZMK

config ZMK_KEYBOARD_NAME
    default "GMMK Pro"

config ZMK_KSCAN_MATRIX_POLLING
    default y

endif # BOARD_GMMK_PRO || BOARD_GMMK_PRO_STM32F303XC_ZMK
```

## boards/glorious/gmmk_pro/Kconfig.gmmk_pro
```kconfig
# Copyright (c) 2025 G3rtz
# SPDX-License-Identifier: MIT

config BOARD_GMMK_PRO
    select SOC_STM32F303XC
    select ZMK_BOARD_COMPAT

config BOARD_GMMK_PRO_STM32F303XC_ZMK
    select ZMK_BOARD_COMPAT
```

## boards/glorious/gmmk_pro/board.yml
```yaml
board:
  name: gmmk_pro
  vendor: glorious
  socs:
    - name: stm32f303xc
      variants:
        - name: zmk
```

## boards/glorious/gmmk_pro/gmmk_pro_defconfig
```kconfig
# Base board fallback config for GMMK Pro.
#
# Some build paths first resolve the base board target (`gmmk_pro`) before
# applying SoC/variant qualifiers. Keep ZMK board-compat enabled here so
# Zephyr 4.1 compatibility checks succeed in that path as well.

CONFIG_SOC_SERIES_STM32F3X=y
CONFIG_SOC_STM32F303XC=y

CONFIG_CLOCK_CONTROL=y
CONFIG_SYS_CLOCK_HW_CYCLES_PER_SEC=72000000

CONFIG_ZMK_USB=y
CONFIG_ZMK_BOARD_COMPAT=y

CONFIG_ZMK_HID_REPORT_TYPE_NKRO=y
```

## boards/glorious/gmmk_pro/gmmk_pro_stm32f303xc_defconfig
```kconfig
# Common options for STM32F303XC board target.
#
# Keep this target explicitly ZMK-compatible so builds that resolve to the
# non-variant SoC target still pass the Zephyr 4.1 ZMK board-compat check.

CONFIG_SOC_SERIES_STM32F3X=y
CONFIG_SOC_STM32F303XC=y

CONFIG_BOARD_GMMK_PRO=y
CONFIG_CORTEX_M_SYSTICK=y

CONFIG_CLOCK_CONTROL=y
CONFIG_SYS_CLOCK_HW_CYCLES_PER_SEC=72000000

CONFIG_USB_DEVICE_STACK=y
CONFIG_USB_CDC_ACM=n
CONFIG_ZMK_USB=y

CONFIG_ZMK_BOARD_COMPAT=y

CONFIG_SERIAL=y
CONFIG_UART_INTERRUPT_DRIVEN=y

CONFIG_MAIN_STACK_SIZE=4096
CONFIG_HEAP_MEM_POOL_SIZE=4096

CONFIG_ZMK_HID_REPORT_TYPE_NKRO=y
```

## boards/glorious/gmmk_pro/gmmk_pro_stm32f303xc_zmk_defconfig
```kconfig
# Copyright (c) 2025 G3rtz
# SPDX-License-Identifier: MIT

# 72MHz system clock
CONFIG_SYS_CLOCK_HW_CYCLES_PER_SEC=72000000

CONFIG_PINCTRL=y

# enable GPIO
CONFIG_GPIO=y

# clock configuration
CONFIG_CLOCK_CONTROL=y

# USB
CONFIG_ZMK_USB=y

# Mark this board target as explicitly ZMK-compatible (Zephyr 4.1 check)
CONFIG_ZMK_BOARD_COMPAT=y

# Encoder
CONFIG_EC11=y
CONFIG_EC11_TRIGGER_GLOBAL_THREAD=y

# NKRO
CONFIG_ZMK_HID_REPORT_TYPE_NKRO=y

# Flash/NVS
CONFIG_FLASH=y
CONFIG_FLASH_MAP=y
CONFIG_NVS=y
CONFIG_SETTINGS_NVS=y
```
