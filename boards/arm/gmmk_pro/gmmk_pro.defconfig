## boards/arm/gmmk_pro/gmmk_pro.defconfig
```kconfig
CONFIG_SOC_SERIES_STM32F3X=y
CONFIG_SOC_STM32F303XC=y
CONFIG_SYS_CLOCK_HW_CYCLES_PER_SEC=72000000

# USB-Konfiguration (VID/PID aus QMK übernehmen)
CONFIG_USB=y
CONFIG_USB_DEVICE_STACK=y
CONFIG_USB_DEVICE_VID=0x320F
CONFIG_USB_DEVICE_PID=0x5044
CONFIG_USB_DEVICE_MANUFACTURER="Glorious"
CONFIG_USB_DEVICE_PRODUCT="GMMK Pro"

# Bootloader (STM32 DFU)
CONFIG_BOOTLOADER_STM32_DFU=y

# NKRO (N-Key Rollover) - mit Kompatibilitätshinweis
CONFIG_ZMK_HID_REPORT_TYPE_NKRO=y
# Achtung: Kann bei einigen Systemen zu Problemen führen (siehe Issue #1460)
CONFIG_ZMK_HID_CONSUMER_REPORT=y
# Encoder-Unterstützung
CONFIG_EC11=y
CONFIG_EC11_TRIGGER_GLOBAL_THREAD=y

# Leistungsoptimierungen
CONFIG_ZMK_SLEEP=y
CONFIG_ZMK_IDLE_TIMEOUT=30000
CONFIG_ZMK_EXT_POWER=y

# Matrix-Optimierungen
CONFIG_ZMK_KSCAN_DEBOUNCE_PRESS_MS=1
CONFIG_ZMK_KSCAN_DEBOUNCE_RELEASE_MS=1
CONFIG_ZMK_KSCAN_MATRIX_WAIT_BETWEEN_OUTPUTS=1


CONFIG_PINCTRL=y

# enable GPIO
CONFIG_GPIO=y

# SPI bitbang for AW20216S LEDs
CONFIG_SPI=y
CONFIG_SPI_BITBANG=y

# clock configuration
CONFIG_CLOCK_CONTROL=y

CONFIG_ZMK_USB=y
```

## config/west.yml
```yaml
manifest:
  remotes:
    - name: zmkfirmware
      url-base: https://github.com/zmkfirmware
    - name: g3rtz
      url-base: https://github.com/G3rtz
  projects:
    - name: zmk
      remote: zmkfirmware
      revision: main
      import: app/west.yml
    - name: zmk-module-aw20216s
      remote: g3rtz
      revision: 724adc819f27280bcb2b4c77ec8de6d159278113
  self:
    path: config
```

## west.yml
```yaml
manifest:
  remotes:
    - name: zmkfirmware
      url-base: https://github.com/zmkfirmware
    - name: g3rtz
      url-base: https://github.com/G3rtz
  projects:
    - name: zmk
      remote: zmkfirmware
      revision: main
      import: app/west.yml
    - name: zmk-module-aw20216s
      remote: g3rtz
      revision: eada2869e8f3583c934644b80646e596508fa7af
  self:
    path: .
```
